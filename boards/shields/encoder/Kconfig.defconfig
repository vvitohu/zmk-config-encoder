## boards/shields/encoder/Kconfig.defconfig
```kconfig
# Copyright (c) 2020 The ZMK Contributors
# SPDX-License-Identifier: MIT

if SHIELD_ENCODER

config ZMK_KEYBOARD_NAME
    default "encoder"


CONFIG_CLOCK_CONTROL_NRF_K32SRC_RC=y


endif
```

## boards/shields/encoder/Kconfig.shield
```kconfig
# Copyright (c) 2020 The ZMK Contributors
# SPDX-License-Identifier: MIT

config SHIELD_ENCODER
    def_bool $(shields_list_contains,encoder)
```
